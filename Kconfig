## Kconfig
```kconfig
menu "VL53L5CX"

    config VL53L5CX_NB_TARGET_PER_ZONE
        int "Number of target per zone"
        range 1 4
        default 1
        help
            The VL53L5CX can measure up to four targets per zone.
            The user can configure the number of targets returned by the sensor.
            The minimum distance between two targets to be detected is 600 mm.
            A lower number of target per zone means a lower RAM

    config VL53L5CX_DISABLE_AMBIENT_PER_SPAD
        bool "Disable ambient per SPAD result"
        default n
        help 
            Disable the ambient per SPAD result.
            Consequently, the field is not declared in the results structure, 
            and the data is not transferred to the host. 
            The RAM size and I2C/SPI size are reduced.

    config VL53L5CX_DISABLE_NB_SPADS_ENABLED
        bool "Disable number of SPADs enabled result"
        default n
        help
            Disable the number of SPADs enabled result.
            Consequently, the field is not declared in the results structure, 
            and the data is not transferred to the host. 
            The RAM size and I2C/SPI size are reduced.

    config VL53L5CX_DISABLE_NB_TARGET_DETECTED
        bool "Disable number of target detected result"
        default n
        help
            Disable the number of target detected result.
            Consequently, the field is not declared in the results structure, 
            and the data is not transferred to the host. 
            The RAM size and I2C/SPI size are reduced.

    config VL53L5CX_DISABLE_SIGNAL_PER_SPAD
        bool "Disable signal per SPAD result"
        default n
        help
            Disable the signal per SPAD result.
            Consequently, the field is not declared in the results structure, 
            and the data is not transferred to the host. 
            The RAM size and I2C/SPI size are reduced.

    config VL53L5CX_DISABLE_RANGE_SIGMA_MM
        bool "Disable range sigma in mm result"
        default n
        help
            Disable the range sigma in mm result.
            Consequently, the field is not declared in the results structure, 
            and the data is not transferred to the host. 
            The RAM size and I2C/SPI size are reduced.

    config VL53L5CX_DISABLE_DISTANCE_MM
        bool "Disable distance in mm result"
        default n
        help
            Disable the distance in mm result.
            Consequently, the field is not declared in the results structure, 
            and the data is not transferred to the host. 
            The RAM size and I2C/SPI size are reduced.

    config VL53L5CX_DISABLE_REFLECTANCE_PERCENT
        bool "Disable reflectance in percent result"
        default n
        help
            Disable the reflectance in percent result.
            Consequently, the field is not declared in the results structure, 
            and the data is not transferred to the host. 
            The RAM size and I2C/SPI size are reduced.

    config VL53L5CX_DISABLE_TARGET_STATUS
        bool "Disable target status result"
        default n
        help
            Disable the target status result.
            Consequently, the field is not declared in the results structure, 
            and the data is not transferred to the host. 
            The RAM size and I2C/SPI size are reduced.

    config VL53L5CX_DISABLE_MOTION_INDICATOR
        bool "Disable motion indicator result"
        default n
        help
            Disable the motion indicator result.
            Consequently, the field is not declared in the results structure, 
            and the data is not transferred to the host. 
            The RAM size and I2C/SPI size are reduced.

    config VL53L5CX_I2C_TIMEOUT
        bool "Enable I²C bus timeout"
        default false

    config VL53L5CX_I2C_TIMEOUT_VALUE
        int "I²C bus timeout"
        depends on VL53L5CX_I2C_TIMEOUT
        default 1000

        choice VL53L5CX_RESET_LEVEL
                    prompt "Reset Pin State"
                    default VL53L5CX_RESET_PIN_LOW
                    help
                        The user can choose if during the reset scheme the reset pin is low or high.
                        This allow different circuits and the user can choose accordingly to his needs.

                    config VL53L5CX_RESET_PIN_LOW
                        bool "Low"
                    config VL53L5CX_RESET_PIN_HIGH
                        bool "High"

        endchoice

endmenu
```
